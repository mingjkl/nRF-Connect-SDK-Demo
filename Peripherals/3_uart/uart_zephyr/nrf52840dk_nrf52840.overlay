
&uart0 {
	status = "okay";
	current-speed = <115200>;
};

&uart0_default {
	group1 {
		psels = <NRF_PSEL(UART_TX, 0, 6)>, <NRF_PSEL(UART_RTS, 0, 5)>;
	};

	group2 {
		psels = <NRF_PSEL(UART_RX, 0, 8)>, <NRF_PSEL(UART_CTS, 0, 7)>;
	};
};
