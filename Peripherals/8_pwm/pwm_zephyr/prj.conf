## prj.conf
```kconfig
CONFIG_PWM=y
```

## nrf52840dk_nrf52840.overlay
```dts
// To get started, press Ctrl+Space to bring up the completion menu and view the available nodes.

// You can also use the buttons in the sidebar to perform actions on nodes.
// Actions currently available include:

// * Enabling / disabling the node
// * Adding the bus to a bus
// * Removing the node
// * Connecting ADC channels

// For more help, browse the DeviceTree documentation at https://docs.zephyrproject.org/latest/guides/dts/index.html
// You can also visit the nRF DeviceTree extension documentation at https://nrfconnect.github.io/vscode-nrf-connect/devicetree/nrfdevicetree.html

&pwm0_default {
    group2 {
        psels = <NRF_PSEL(PWM_OUT1, 0, 29)>, <NRF_PSEL(PWM_OUT2, 0, 28)>;
    };
};

&pwm0 {
    status = "okay";
};
```

## src/main.c
```c
/*
 * Copyright (c) 2012-2014 Wind River Systems, Inc.
 *
 * SPDX-License-Identifier: Apache-2.0
 */

#include <zephyr/kernel.h>
#include <zephyr/drivers/pwm.h>
#include <zephyr/device.h>
#include <zephyr/devicetree.h>


static const struct device *pwm_dev = DEVICE_DT_GET(DT_NODELABEL(pwm0));

int main(void)
{

	int ret;

	if(!device_is_ready(pwm_dev)){
		printk("PWM device is not ready\n");
		return -1;
	}
	else{
		printk("PWM device is ready\n");
	}

	uint32_t freq = 1000;						   // Hz
	uint32_t pulse_width = 25;					   // percentage
	uint32_t period = 1000000000 / freq;		   // ns
	uint32_t pulse = (period * pulse_width) / 100; // ns

	ret = pwm_set(pwm_dev, 1, period, pulse, NULL);
	ret = pwm_set(pwm_dev, 2, period, pulse * 2, NULL);
	printk("PWM set returned %d\n", ret);


	return 0;
}
```
